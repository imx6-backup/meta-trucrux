## conf/layer.conf
```bitbake
#We have a conf and classes directory, add to BBPATH
BBPATH .= ":${LAYERDIR}"

# We have a packages directory, add to BBFILES
BBFILES += "${LAYERDIR}/recipes-*/*/*.bb \
            ${LAYERDIR}/recipes-*/*/*.bbappend"

BBFILE_COLLECTIONS += "trucrux"
BBFILE_PATTERN_trucrux := "^${LAYERDIR}/"
BBFILE_PRIORITY_trucrux = "9"

LAYERDEPENDS_trucrux = "core fsl-arm"
```

## conf/machine/imx6-truxd01.conf
```bitbake
#@TYPE: Machine
#@NAME: Trucrux-TRUX-D01
#@SOC: i.MX6UL/ULL
#@DESCRIPTION: Machine configuration for Trucrux-TRUX-D01

include conf/machine/include/imx-base.inc
include conf/machine/include/tune-cortexa7.inc
include conf/machine/include/imx6ul-common.inc


PREFERRED_PROVIDER_virtual/kernel_mx6ul = "linux-truxd01"
PREFERRED_PROVIDER_virtual/bootloader = "u-boot-truxd01"
PREFERRED_PROVIDER_u-boot_mx6ul = "u-boot-truxd01"

MACHINE_FEATURES += " pci wifi bluetooth"

SOC_FAMILY = "mx6ul:mx6ull"

KERNEL_DEVICETREE = "imx6ul-truxd01-som.dtb \
		     imx6ull-truxd01-som.dtb"

IMAGE_FSTYPES = "tar.bz2 ext4 sdcard"

UBOOT_CONFIG ??= "nand"
UBOOT_CONFIG[nand] = "imx6_truxd01_som_defconfig,ubifs"
UBOOT_CONFIG[mfgtool] = "imx6_truxd01_som_mfg_defconfig"
BOOT_MAKE_TARGET = ""
TRUXD01_KERNEL_DEFCONFIG = "trux_imx6uld01_som_defconfig"
KERNEL_IMAGETYPE_imx6-truxd01 = "zImage"
IMAGE_INSTALL_append = "kernel-modules udev udev-extraconf packagegroup-fsl-tools-testapps tslib tslib-calibrate tslib-tests imx-test linux-firmware-ralink wpa-supplicant"
```

## conf/machine/imx6-truxq01.conf
```bitbake
#@TYPE: Machine
#@NAME: Trucrux-TRUX-Q01
#@SOC: i.MX6UL/ULL
#@DESCRIPTION: Machine configuration for Trucrux-TRUX-Q01

include conf/machine/include/imx-base.inc
include conf/machine/include/tune-cortexa7.inc
include conf/machine/include/imx6ul-common.inc


PREFERRED_PROVIDER_virtual/kernel_mx6ul = "linux-truxq01"
PREFERRED_PROVIDER_virtual/bootloader = "u-boot-truxq01"
PREFERRED_PROVIDER_u-boot_mx6ul = "u-boot-truxq01"

MACHINE_FEATURES += " pci wifi bluetooth"

SOC_FAMILY = "mx6ul:mx6ull"

KERNEL_DEVICETREE = "imx6ul-truxq01-som.dtb \
		     imx6ull-truxq01-som.dtb"

IMAGE_FSTYPES = "tar.bz2 ext4 sdcard"

UBOOT_CONFIG ??= "nand"
UBOOT_CONFIG[nand] = "imx6_truxq01_som_defconfig,ubifs"
UBOOT_CONFIG[mfgtool] = "imx6_truxq01_som_mfg_defconfig"
BOOT_MAKE_TARGET = ""
TRUXQ01_KERNEL_DEFCONFIG = "trux_imx6ulq01_som_defconfig"
KERNEL_IMAGETYPE_imx6-truxq01 = "zImage"
IMAGE_INSTALL_append = "kernel-modules udev udev-extraconf truxtest packagegroup-fsl-tools-testapps tslib tslib-calibrate tslib-tests imx-test linux-firmware-ralink wpa-supplicant"
```
